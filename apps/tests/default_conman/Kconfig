## apps/tests/default_conman/Kconfig
```kconfig
#
# For a description of the syntax of this configuration file,
# see misc/tools/kconfig-language.txt.
#

menuconfig TESTS_DEFAULT_CONMAN
    bool "Connection manager testing utilities library"
    default n
    ---help---
        This library is utilized by some test applications and
        offers them some re-usable functions

if TESTS_DEFAULT_CONMAN

config TESTS_DEFAULT_CONMAN_DEFAULT_WLAN_SSID
    string "Default WLAN SSID"
    default "HaltianGuest"
    ---help---
        What SSID to configure for default WLAN connection
        created with connection manager application

choice TESTS_DEFAULT_CONMAN_DEFAULT_WLAN_ENCRYPTION
    prompt "Default WLAN encryption type"
    default TESTS_DEFAULT_CONMAN_DEFAULT_WLAN_ENCRYPTION_WPA2
    ---help---
        Choose encryption method for default SSID used with
        connection manager testing

config TESTS_DEFAULT_CONMAN_DEFAULT_WLAN_ENCRYPTION_NONE
    bool "None"
    ---help---
        Try to connect with public network

config TESTS_DEFAULT_CONMAN_DEFAULT_WLAN_ENCRYPTION_WEP
    bool "wep"
    ---help---
        Try to use WEP encryption

config TESTS_DEFAULT_CONMAN_DEFAULT_WLAN_ENCRYPTION_WPA
    bool "wpa"
    ---help---
        Try to use WPA encryption

config TESTS_DEFAULT_CONMAN_DEFAULT_WLAN_ENCRYPTION_WPA2
    bool "wpa2"
    ---help---
        Try to use WPA2 encryption

endchoice

config TESTS_DEFAULT_CONMAN_DEFAULT_WLAN_ENCRYPTION
    string
    default "wep" if TESTS_DEFAULT_CONMAN_DEFAULT_WLAN_ENCRYPTION_WEP
    default "wpa" if TESTS_DEFAULT_CONMAN_DEFAULT_WLAN_ENCRYPTION_WPA
    default "wpa2" if TESTS_DEFAULT_CONMAN_DEFAULT_WLAN_ENCRYPTION_WPA2

config TESTS_DEFAULT_CONMAN_DEFAULT_WLAN_PASS
    string "Default WLAN passphrase"
    ---help---
        Set the passphrase for default WLAN connection
        used in connection manager test

config TESTS_DEFAULT_CONMAN_DEFAULT_2G_APN
    string "Default data connection APN"
    default "internet"
    ---help---
        Configure APN name for cellular internet connection

endif
```

## apps/tests/testing/Kconfig
```kconfig
#
# For a description of the syntax of this configuration file,
# see misc/tools/kconfig-language.txt.
#

config BUILD_GTEST
    bool "Build google-test applications"
    default n
    ---help---
        Google-test framework is suited very good for isolated high-performance
        unit testing. This configuration option enables compilation of included
        test applications along with the NuttX codebase.

        The executables will be collected under tests/apps folder.
```

## apps/tests/unity_conman/Kconfig
```kconfig
#
# For a description of the syntax of this configuration file,
# see misc/tools/kconfig-language.txt.
#

menuconfig TESTS_UNITY_CONMAN
    bool "Automated conman test"
    default n
    depends on SYSTEM_CONMAN
    select TESTS_DEFAULT_CONMAN
    ---help---
        Enable automated conman test
```

## apps/tests/unity_dev_err/Kconfig
```kconfig
#
# For a description of the syntax of this configuration file,
# see misc/tools/kconfig-language.txt.
#

config TESTS_UNITY_DEV_ERR
	bool "/dev/err driver test"
	default n
	---help---
		Enable /dev/err driver test
```

## apps/tests/unity_host/Kconfig
```kconfig
#
# For a description of the syntax of this configuration file,
# see misc/tools/kconfig-language.txt.
#

config TESTS_UNITY_HOST
	bool "Host-side Unity framework test"
	default n
	---help---
		Enable host-side Unity framework test
```

## apps/tests/unity_libm/Kconfig
```kconfig
#
# For a description of the syntax of this configuration file,
# see misc/tools/kconfig-language.txt.
#

config TESTS_UNITY_LIBM
	bool "Automated math library test"
	default n
	---help---
		Enable automated math library test
```

## apps/tests/unity_pwrbtn/Kconfig
```kconfig
#
# For a description of the syntax of this configuration file,
# see misc/tools/kconfig-language.txt.
#

config TESTS_UNITY_PWRBTN
	bool "Power button driver test"
	default n
    depends on ARCH_CHIP_STM32
	---help---
		Enable power button driver test
```

## apps/tests/unity_usrsock/Kconfig
```kconfig
#
# For a description of the syntax of this configuration file,
# see misc/tools/kconfig-language.txt.
#

config TESTS_UNITY_USRSOCK
    bool "User socket test"
    default n
    depends on NET
    ---help---
        Enable user socket Unity test
```

## apps/thingsee/Kconfig
```kconfig
source "$APPSDIR/thingsee/bluetooth/Kconfig"
source "$APPSDIR/thingsee/charger/Kconfig"
source "$APPSDIR/thingsee/emmc/Kconfig"
source "$APPSDIR/thingsee/gps/Kconfig"
source "$APPSDIR/thingsee/lib/Kconfig"
source "$APPSDIR/thingsee/nineaxls/Kconfig"
source "$APPSDIR/thingsee/system_properties/Kconfig"
source "$APPSDIR/thingsee/ui/Kconfig"
```

## apps/thingsee/bluetooth/Kconfig
```kconfig
#
# For a description of the syntax of this configuration file,
# see misc/tools/kconfig-language.txt.
#

config THINGSEE_BLUETOOTH_MODULE
	bool "Thingsee bluetooth module support"
	default n
	---help---
		Enable the Thingsee application support for bluetooth module
```

## apps/thingsee/charger/Kconfig
```kconfig
#
# For a description of the syntax of this configuration file,
# see misc/tools/kconfig-language.txt.
#

menuconfig THINGSEE_CHARGER_MODULE
	bool "Thingsee charger module support"
	default n
	depends on THINGSEE_LIB
	select BQ24251_CHARGER
	---help---
		Enable the Thingsee application support for charger module
		
if THINGSEE_CHARGER_MODULE

config THINGSEE_CHARGER_MODULE_DBG
	bool "Thingsee charger module debug support"
	default n
	---help---
		Enable the Thingsee application trace support for charger module

endif
```

## apps/thingsee/emmc/Kconfig
```kconfig
#
# For a description of the syntax of this configuration file,
# see misc/tools/kconfig-language.txt.
#

menuconfig THINGSEE_EMMC_MODULE
	bool "Thingsee eMMC module support"
	default n
	depends on THINGSEE_LIB
	---help---
		Enable the Thingsee application support for eMMC module
		
if THINGSEE_EMMC_MODULE

	config THINGSEE_EMMC_MODULE_DBG
		bool "Thingsee eMMC module debug support"
		default n
		---help---
			Enable the Thingsee application trace support for eMMC module

	config LOG_FILE_NAME
		string "Offline logs file name"
		default "LOGS.txt"
		---help---
			Log file name used for sensors

endif
```

## apps/thingsee/gps/Kconfig
```kconfig
#
# For a description of the syntax of this configuration file,
# see misc/tools/kconfig-language.txt.
#

config THINGSEE_GPS_MODULE
	bool "Thingsee u-blox 7 GPS module support"
	default n
	depends on THINGSEE_LIB && SERIAL_TERMIOS
	---help---
		Enable the Thingsee application support for u-blox 7 GPS module
```

## apps/thingsee/lib/Kconfig
```kconfig
#
# For a description of the syntax of this configuration file,
# see misc/tools/kconfig-language.txt.
#

menuconfig THINGSEE_LIB
	bool "Thingsee library"
	default n
	---help---
		Enable the Thingsee library

if THINGSEE_LIB

config THINGSEE_CORE_MAX_POLL_TIMEOUT_MSEC
	int "Maximum timeout for main-event loop poll"
	default 2500
	---help---
		Shorter timeout value allow faster entry to deep-sleep, but increase
		application CPU usage when deep-sleep cannot be entered.

config THINGSEE_DEEPSLEEP_DISABLED
	bool "Thingsee deep-sleep disabled"
	default n
	---help---
		Disable deep-sleep in Thingsee core.

config THINGSEE_DEEPSLEEP_DEBUG
	bool "Thingsee deep-sleep debugging"
	default n
	---help---
		Enable debugging to trace deep-sleep handling in Thingsee core.

config THINGSEE_DEEPSLEEP_WATCHDOG
	bool "Thingsee deep-sleep watchdog"
	default n
	---help---
		Enable Thingsee core deep-sleep watchdog which performs a system reset
		in case device has not entered deep-sleep within given time

config THINGSEE_DEEPSLEEP_WATCHDOG_TIMEOUT
	int "Thingsee deep-sleep watchdog timeout"
	default 1200
	---help---
		Deep-sleep watchdog timeout in seconds

config THINGSEE_MAINLOOP_LOCKER
    bool "Thingsee main event loop locker, for production tester"
    default false
    ---help---
        Production tester thread needs to lock execution of main event loop
        before changing module state.

config THINGSEE_DISABLE_DEVICE_INFO_TABLE
    bool "Disable MCU UID to device PSN mapping table"
    default false
    ---help---
        This is needed for B1.0 and B1.2 prototype devices, as they do have
        have production data stored on EEPROM.

endif
```

## apps/thingsee/nineaxls/Kconfig
```kconfig
#
# For a description of the syntax of this configuration file,
# see misc/tools/kconfig-language.txt.
#

menuconfig THINGSEE_NINEAXELS_MODULE
	bool "Thingsee 9-axels sensor's module support"
	default n
	depends on THINGSEE_LIB
	---help---
		Enable the Thingsee application support for 9-axels sensor's module

if THINGSEE_NINEAXELS_MODULE
	choice
	prompt "Thingsee Sensor Fusion Algorithm"
	default THINGSEE_NINEAXELS_FUSION_MADGWICK

	config THINGSEE_NINEAXELS_FUSION_MADGWICK
		bool "Madgwick orientation filter"
		---help---
			Madgwick's sensor fusion algorithm for IMUs. Algorithm
			combines acceleration, rotation rate, and magnetic moments
			to produce a quaternion-based estimate of absolute device
			orientation which can then be converted to yaw, pitch,
			and roll.

	config THINGSEE_NINEAXELS_FUSION_MAHONY
		bool "Mahony orientation filter"
		---help---
			Mahony orientation filter for IMUs.

	endchoice
endif
```

## apps/thingsee/system_properties/Kconfig
```kconfig
#
# For a description of the syntax of this configuration file,
# see misc/tools/kconfig-language.txt.
#

config SYSTEM_PROPERTIES_INT
    bool "System properties interface"
    default n
    ---help---
        Enables system properties interface
```

## apps/thingsee/ui/Kconfig
```kconfig
# For a description of the syntax of this configuration file,
# see misc/tools/kconfig-language.txt.
#

config THINGSEE_UI
    bool "Thingsee UI"
    default n
    ---help---
        Enable Thingsee UI

if THINGSEE_UI
    config THINGSEE_UI_DFU_MODE
        bool "Enable reboot to DFU-mode feature"
        default n
        ---help---
            Enable menu-item for rebooting into DFU-mode

    config THINGSEE_UI_DEBUG
        bool "Enable UI debug traces"
        default n
        ---help---
            Enable UI debug traces
endif
```

## apps/ts_engine/Kconfig
```kconfig
#
# For a description of the syntax of this configuration file,
# see misc/tools/kconfig-language.txt.
#

config THINGSEE_ENGINE
	bool "Thingsee engine"
	default n
	select THINGSEE_LIB
	select THINGSEE_CHARGER_MODULE
	---help---
		Enable the Thingsee engine

if THINGSEE_ENGINE

config THINGSEE_ENGINE_CONNECTION_CUTOFF_TIME
	int "Thingsee connection cut-off time"
	default 30
	---help---
		Close connection after this amount of inactivity time.

config THINGSEE_ENGINE_EEPROM
	bool "Thingsee eeprom support"
	default n
	---help---
		Enable the Thingsee engine EEPROM support

config THINGSEE_ENGINE_UI
	bool "Thingsee engine UI"
	default y
	---help---
		Enable the Thingsee engine UI

config THINGSEE_ENGINE_DBG
	bool "Thingsee engine debug"
	default n
	depends on THINGSEE_ENGINE
	---help---
		Enable the Thingsee engine debugs

config THINGSEE_ENGINE_SENSE_TEMPERATURE
	bool "Thingsee engine sense temperature"
	default y
	depends on THINGSEE_ENGINE
	select HTS221_HUMIDITY
	depends on I2C_PRESSURE_DEV_LPS25H
	---help---
		Enable the Thingsee engine temperature sense

config THINGSEE_ENGINE_SENSE_HUMIDITY
	bool "Thingsee engine sense humidity"
	default y
	depends on THINGSEE_ENGINE
	depends on HTS221_HUMIDITY
	---help---
		Enable the Thingsee engine humidity sense

config THINGSEE_ENGINE_SENSE_PRESSURE
	bool "Thingsee engine sense pressure"
	default y
	depends on THINGSEE_ENGINE
	depends on I2C_PRESSURE_DEV_LPS25H
	---help---
		Enable the Thingsee engine pressure sense

config THINGSEE_ENGINE_SENSE_AMBIENT_LIGHT
	bool "Thingsee engine sense ambient light"
	default y
	depends on THINGSEE_ENGINE
	depends on MAX44009_SENSOR
	---help---
		Enable the Thingsee engine ambient light sense

config THINGSEE_ENGINE_SENSE_LOCATION
	bool "Thingsee engine sense location"
	default y
	depends on THINGSEE_ENGINE
	select THINGSEE_GPS_MODULE
	---help---
		Enable the Thingsee engine location sense

config THINGSEE_ENGINE_SENSE_ACCELERATION
	bool "Thingsee engine sense acceleration"
	default y
	depends on THINGSEE_ENGINE
	depends on LIS2DH || LSM9DS1_SENS
	---help---
		Enable the Thingsee engine acceleration sense

config THINGSEE_ENGINE_SENSE_IMPACT
	bool "Thingsee engine sense impact"
	default y
	depends on THINGSEE_ENGINE
	depends on  LIS2DH
	---help---
		Enable the Thingsee engine impact sense

config THINGSEE_ENGINE_SENSE_MAGNETIC_FIELD
	bool "Thingsee engine sense magnetic field"
	default y
	depends on THINGSEE_ENGINE
	depends on LSM9DS1_SENS
	---help---
		Enable the Thingsee engine magnetic field sense

config THINGSEE_ENGINE_SENSE_ORIENTATION
	bool "Thingsee engine sense orientation"
	default y
	depends on THINGSEE_ENGINE
	depends on LSM9DS1_SENS
	---help---
		Enable the Thingsee engine orientation sense

config THINGSEE_ENGINE_SENSE_SPEED
	bool "Thingsee engine sense speed"
	default y
	depends on THINGSEE_ENGINE
	depends on THINGSEE_GPS_MODULE
	---help---
		Enable the Thingsee engine speed sense

config THINGSEE_ENGINE_SENSE_ENERGY
	bool "Thingsee engine sense energy"
	default y
	depends on THINGSEE_ENGINE
	depends on THINGSEE_CHARGER_MODULE
	---help---
		Enable the Thingsee engine energy sense

config THINGSEE_ENGINE_SENSE_TIME
	bool "Thingsee engine sense time"
	default y
	depends on THINGSEE_ENGINE
	---help---
		Enable the Thingsee engine time sense

config THINGSEE_ENGINE_PING
	bool "Thingsee engine retry ping"
	default y
	depends on THINGSEE_ENGINE
	---help---
		Enable the Thingsee ping feature if backend supports retry pings

source "$APPSDIR/ts_engine/control/Kconfig"
endif

source "$APPSDIR/ts_engine/connectors/Kconfig"
```

## apps/ts_engine/connectors/Kconfig
```kconfig
#
# For a description of the syntax of this configuration file,
# see misc/tools/kconfig-language.txt.
#

config THINGSEE_CONNECTORS
    bool "Thingsee connectors"
    default n
    ---help---
        Enable the Thingsee connectors

if THINGSEE_CONNECTORS
    config THINGSEE_HTTPS_PROTOCOL
        bool "Enables HTTPS protocol"
        depends on MBEDTLS
        default n
        ---help---
            Enable HTTPS protocol (see separate mbedTLS config section for TLS
            configuration).

    config THINGSEE_MQTT_PROTOCOL
        bool "Enables MQTT protocol"
        default n
        ---help---
            Enable MQTT protocol

    config THINGSEE_CONNECTORS_DEBUG
        bool "Thingsee connector debug"
        default n
        ---help---
            Enable the thingsee connectors debug

    config THINGSEE_CONNECTORS_PROTOCOL_DEBUG
        bool "Thingsee connector protocol debug"
        default n
        ---help---
            Enable verbose network protocol debugging traces (HTTP, etc)

    config ONLY_CONNECTOR_CORE_LIBRARY
        bool "Only build connector core library, without individual connectors"
        default n
        ---help---
            Only build connector core library, and disable building
            connectors Thingsee Engine. Allows using connector core
            with custom application connector(s).

    if !ONLY_CONNECTOR_CORE_LIBRARY

    source "$APPSDIR/ts_engine/connectors/Kconfig_extra"

    endif
endif
```

## apps/ts_engine/control/Kconfig
```kconfig
#
# For a description of the syntax of this configuration file,
# see misc/tools/kconfig-language.txt.
#

config THINGSEE_ENGINE_CONTROL
	bool "Thingsee engine control app"
	default n
	---help---
		Enable the Thingsee engine control app
```
