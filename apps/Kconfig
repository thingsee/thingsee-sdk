## apps/Kconfig
```kconfig
#
# For a description of the syntax of this configuration file,
# see misc/tools/kconfig-language.txt.
#

menu "Thingsee platform"
source "$APPSDIR/thingsee/Kconfig"
endmenu

menu "Thingsee engine"
source "$APPSDIR/ts_engine/Kconfig"
endmenu

menu "Built-In Applications"
source "$APPSDIR/builtin/Kconfig"
endmenu

menu "Examples"
source "$APPSDIR/examples/Kconfig"
endmenu

menu "Graphics Support"
source "$APPSDIR/graphics/Kconfig"
endmenu

menu "Interpreters"
source "$APPSDIR/interpreters/Kconfig"
endmenu

menu "Network Utilities"
source "$APPSDIR/netutils/Kconfig"
endmenu

menu "FreeModBus"
source "$APPSDIR/modbus/Kconfig"
endmenu

menu "NSH Library"
source "$APPSDIR/nshlib/Kconfig"
endmenu

menu "NxWidgets/NxWM"
source "$APPSDIR/NxWidgets/Kconfig"
endmenu

menu "Platform-specific Support"
source "$APPSDIR/platform/Kconfig"
endmenu

menu "System Libraries and NSH Add-Ons"
source "$APPSDIR/system/Kconfig"
endmenu

menu "Automated test applications"
source "$APPSDIR/tests/Kconfig"
endmenu

source "$APPSDIR/Kconfig_extra"
```

## apps/examples/boot2dfu/Kconfig
```kconfig
#
# For a description of the syntax of this configuration file,
# see misc/tools/kconfig-language.txt.
#

config EXAMPLES_BOOT2DFU
	bool "Boot-to-DFU-mode util"
	default n
	---help---
		Enable Boot-to-DFU-mode util
```

## apps/examples/cbordump/Kconfig
```kconfig
#
# For a description of the syntax of this configuration file,
# see misc/tools/kconfig-language.txt.
#

menuconfig EXAMPLES_CBORDUMP
	bool "CBOR dump tool"
	default n
	depends on NETUTILS_TINYCBOR
	---help---
		Enable the CBOR dump tool
```

## apps/examples/coap_cli/Kconfig
```kconfig
#
# For a description of the syntax of this configuration file,
# see misc/tools/kconfig-language.txt.
#

menuconfig EXAMPLES_COAP_CLIENT
	bool "CoAP client"
	default n
	depends on NETUTILS_LIBCOAP
	---help---
		Enable the CoAP client util
```

## apps/examples/fota/Kconfig
```kconfig
#
# For a description of the syntax of this configuration file,
# see misc/tools/kconfig-language.txt.
#

menu "FOTA for Thingsee One"
config SYSTEM_FOTA
	bool "FOTA"
	default n
	select NETUTILS_WEBCLIENT
	---help---
		Enable the simple FOTA example for Thingsee One

if SYSTEM_FOTA


config SYSTEM_FOTA_HOST_ADDRESS
	string "Host IP address"
	default "www.yourhosthere.com"
	---help---
		Fota will check for updates from this address.

config SYSTEM_FOTA_HOST_PATH
	string "Host path to fota files"
	default "thingsee"
	---help---
		Fota will check for updates from http://[host]/[path]/

config SYSTEM_FOTA_INTERVAL_HOURS
	int "FOTA interval in hours"
	default 24
	---help---
		The FOTA app firmware check interval in hours.

config SYSTEM_FOTA_DEBUG
	bool "Enable FOTA debug"
	default n
	---help---
		Enable FOTA debug.

endif
endmenu
```

## apps/examples/netcat/Kconfig
```kconfig
#
# For a description of the syntax of this configuration file,
# see misc/tools/kconfig-language.txt.
#

menuconfig EXAMPLES_NETCAT
	bool "netcat util"
	default n
	depends on NET
	---help---
		Enable the netcat util
```

## apps/examples/ntpclient/Kconfig
```kconfig
#
# For a description of the syntax of this configuration file,
# see misc/tools/kconfig-language.txt.
#

config EXAMPLES_NTPCLIENT
	bool "NTP client example"
	default n
	depends on NETUTILS_NTPCLIENT
	---help---
		Enable the NTP client example

if EXAMPLES_NTPCLIENT

config EXAMPLES_NTPCLIENT_PROGNAME
	string "Program name"
	default "ntpclient"
	depends on BUILD_KERNEL
	---help---
		This is the name of the program that will be use when the NSH ELF
		program is installed.

endif
```

## apps/examples/reboot/Kconfig
```kconfig
#
# For a description of the syntax of this configuration file,
# see misc/tools/kconfig-language.txt.
#

config EXAMPLES_REBOOT
	bool "Reboot-device util"
	default n
	---help---
		Enable Reboot-device util
```

## apps/examples/standby/Kconfig
```kconfig
#
# For a description of the syntax of this configuration file,
# see misc/tools/kconfig-language.txt.
#

config EXAMPLES_STANDBY
	bool "Boot-to-standby util"
	default n
	---help---
		Enable Boot-to-standby util
```

## apps/examples/stepper/Kconfig
```kconfig
#
# For a description of the syntax of this configuration file,
# see misc/tools/kconfig-language.txt.
#

config EXAMPLES_STEPPER
	bool "Stepper motor example"
	default n
	depends on NSH_BUILTIN_APPS
	depends on STEPPER
	---help---
		Enable the stepper motor example
```

## apps/examples/thingsee_demos/Kconfig
```kconfig
#
# For a description of the syntax of this configuration file,
# see misc/tools/kconfig-language.txt.
#

config EXAMPLES_THINGSEE_DEMOS
	bool "Thingsee demos"
	default n
	---help---
		Enable Thingsee demos

if EXAMPLES_THINGSEE_DEMOS
endif
```

## apps/examples/ubgps_nmea/Kconfig
```kconfig
#
# For a description of the syntax of this configuration file,
# see misc/tools/kconfig-language.txt.
#

config EXAMPLES_UBGPS_NMEA
	bool "u-blox GPS NMEA console output util"
	default n
	depends on NET
	---help---
		Enable ubgps NMEA to console util
```

## apps/examples/ubmodem/Kconfig
```kconfig
#
# For a description of the syntax of this configuration file,
# see misc/tools/kconfig-language.txt.
#

menuconfig EXAMPLES_UBMODEM
	bool "u-blox Cellular modem library example"
	default n
	depends on SYSTEM_UBMODEM
	---help---
		Enable the u-blox Cellular modem library example

if EXAMPLES_UBMODEM

config EXAMPLES_UBMODEM_DAEMONPRIO
	int "ubmodemd daemon priority"
	default 100
	---help---
		Priority of the ubmodemd daemon.  Default: 100

config EXAMPLES_UBMODEM_DAEMONSTACKSIZE
	int "ubmodemd daemon stack size"
	default 2048
	---help---
		Stack size allocated for the ubmodemd daemon. Default: 2048

config EXAMPLES_UBMODEM_SIMPIN
	string "PIN code for used SIM card"
	default "1234"
	---help---
		PIN for SIM card

config EXAMPLES_UBMODEM_APN_NAME
	string "APN name"
	default "internet"
	---help---
		APN name to use for Internet connection

config EXAMPLES_UBMODEM_APN_USER
	string "APN username"
	default ""
	---help---
		Username for APN

config EXAMPLES_UBMODEM_APN_PASSWD
	string "APN password"
	default ""
	---help---
		Password for APN

config EXAMPLES_UBMODEM_APN_IPADDR
	string "APN ip-address"
	default "0.0.0.0"
	---help---
		IP address for APN connection. Default: 0.0.0.0 (get dynamic IP)

config EXAMPLES_UBMODEM_DEBUG
	bool "ubmodemd daemon debugging"
	default n
	---help---
		Enable debugging output for ubmodemd

config EXAMPLES_UBMODEM_VERBOSE
	bool "ubmodemd daemon verbose debugging"
	default n
	depends on EXAMPLES_UBMODEM_DEBUG
	---help---
		Enable verbose debugging output for ubmodemd

endif
```

## apps/examples/usrsocktest/Kconfig
```kconfig
#
# For a description of the syntax of this configuration file,
# see misc/tools/kconfig-language.txt.
#

config EXAMPLES_USRSOCKTEST
	bool "USRSOCK test example"
	default n
	depends on NET && NET_USRSOCK && NET_USRSOCK_TCP && NET_USRSOCK_UDP
	select PIPES
	---help---
		Enable the User Socket test example. This example application runs
		unit-tests for /dev/usrsock.
```

## apps/external/example_app/Kconfig
```kconfig
#
# For a description of the syntax of this configuration file,
# see misc/tools/kconfig-language.txt.
#

menu "Thingsee SDK example application"

config SDK_EXAMPLE_APP
	bool "Thingsee SDK example application"
	default n
	select THINGSEE_LIB
	select THINGSEE_CHARGER_MODULE
	---help---
		Enable the example application

if SDK_EXAMPLE_APP

config SDK_EXAMPLE_APP_DBG
	bool "Example application debugging"
	default n
	---help---
		Enable the application debug

config SDK_EXAMPLE_APP_ASSERT_COUNT_RESET_SECS
	int
	default 300

config SDK_EXAMPLE_APP_GPS_LOCATION_INTERVAL
	int "Time between GPS locations"
	default 300
	---help---
		Time interval between GPS location queries in seconds.

config SDK_EXAMPLE_APP_RADIO_ENVIRONMENT_INTERVAL
	int "Time between radio environment scans (cellular & WiFi)"
	default 60
	---help---
		Time interval between radio environment queries in seconds.

config SDK_EXAMPLE_APP_ACCEL_IMPACT_THRESHOLD
	int "Accelerometer wake-up impact threshold in milli-G's"
	default 200
	---help---
		Defines threshold of acceleration that will generate interrupt and
		wake-up device. Low acceleration threshold such as 0.2 g (200 value
		here), will allow wake-up from even smallest movements.

config SDK_EXAMPLE_APP_ACCEL_RESTART_TIME
	int "Accelerometer restart time in seconds"
	default 5
	---help---
		If this setting is set to non-zero value, accelerometer is disabled
		for amount of time set here after waking up. If set to zero,
		accelerometer is kept on.

choice SDK_EXAMPLE_APP_CONNECTION_TYPE
	prompt "Make network connection with: "

config SDK_EXAMPLE_APP_CONNECTION_MODEM
	bool "Modem"
	default y

config SDK_EXAMPLE_APP_CONNECTION_WIFI
	bool "WiFi"
	default n

endchoice #SDK_EXAMPLE_APP_CONNECTION_TYPE

config SDK_EXAMPLE_APP_CONNECTION_SIM_PIN
	string "Modem PIN"
	default "0000"
	---help---
		Used only if SIM has PIN enabled.

config SDK_EXAMPLE_APP_CONNECTION_SIM_APN_NAME
	string "Modem APN name"
	default "internet"

config SDK_EXAMPLE_APP_CONNECTION_SIM_APN_USER
	string "Modem APN username"
	default ""
	---help---
		Leave empty if not needed.

config SDK_EXAMPLE_APP_CONNECTION_SIM_APN_PASSWD
	string "Modem APN password
	default ""
	---help---
		Leave empty if not needed.

config SDK_EXAMPLE_APP_CONNECTION_WIFI_SSID
	string "WiFi SSID"
	default "AccessPoint"

config SDK_EXAMPLE_APP_CONNECTION_WIFI_PSK
	string "WiFi WPA2 PSK"
	default "01234567"

config SDK_EXAMPLE_APP_HTTP_CLOUD_URL
	string "Cloud URL for radio environment JSON dump (http or https protocol)"
	default "https://api.thingsee.com/test"

config SDK_EXAMPLE_APP_HTTP_CLOUD_METHOD
	string "Cloud URL HTTP method"
	default "POST"

config SDK_EXAMPLE_APP_HTTP_CLOUD_EXTRA_HEADER
	string "Cloud extra HTTP headers"
	default "User: test\\r\\nPassword: 1234\\r\\n"

endif #SDK_EXAMPLE_APP

endmenu
```

## apps/netutils/json/Kconfig
```kconfig
#
# For a description of the syntax of this configuration file,
# see misc/tools/kconfig-language.txt.
#

config NETUTILS_JSON
	bool "cJSON library"
	default n
	---help---
		Enables the cJSON library.  cJSON is an ultra-lightweight, portable,
		single-file, simple-as-can-be ANSI-C compliant JSON parser, under MIT
		license. Embeddable Lightweight XML-RPC Server discussed at
		http://www.drdobbs.com/web-development/an-embeddable-lightweight-xml-rpc-server/184405364.
		This code was taken from http://sourceforge.net/projects/cjson/ and
		adapted for NuttX by Darcy Gong.

if NETUTILS_JSON
config NETUTILS_JSON_PARSE_IGNORE_MISSING_NULL_TERMINATOR
	bool "Ignore missing NULL terminator"
	default n
	---help---
		Allow cJSON parser to ignore missing NULL terminator after
		parsed object. This is the old behavior for cJSON, not matching JSON
		spec.
endif
```

## apps/netutils/libcoap/Kconfig
```kconfig
#
# For a description of the syntax of this configuration file,
# see misc/tools/kconfig-language.txt.
#

menuconfig NETUTILS_LIBCOAP
	bool "CoAP library (Constrained Application Protocol, RFC 7252)"
	default n
	depends on NET && NET_UDP
	select DEV_RANDOM
	---help---
		libcoap: C-Implementation of CoAP

		libcoap implements a lightweight application-protocol for devices that
		are constrained their resources such as computing power, RF range,
		memory, bandwith, or network packet sizes. This protocol, CoAP was
		standardized in the IETF as RFC 7252.

if NETUTILS_LIBCOAP

config LIBCOAP_CUSTOM_IO
	bool "Use application provided I/O layer for libcoap"
	default n
	---help---
		Allow application to implement I/O layer for libcoap. For example,
		for DTLS support.

config LIBCOAP_DISABLE_DEBUG
	bool "Disable debug traces and util functions in libcoap"
	default n
	---help---
		Disable debugging

endif # NETUTILS_LIBCOAP
```
