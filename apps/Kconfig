## apps/netutils/mbedtls/Kconfig
```kconfig
#
# For a description of the syntax of this configuration file,
# see misc/tools/kconfig-language.txt.
#

menuconfig MBEDTLS
	bool "mbedTLS TLS library"
	default n
	---help---
		Enable mbedTLS library for TLS support.

if MBEDTLS

config MBEDTLS_SERVER
	bool "Enable TLS server support"
	default n
	---help---
		Enable TLS server support.

config MBEDTLS_CLIENT
	bool "Enable TLS client support"
	default y
	---help---
		Enable TLS client support.

config MBEDTLS_SSL3
	bool "Enable SSL 3.0 support"
	default n
	select MBEDTLS_ENABLE_CBC
	select MBEDTLS_ENABLE_MD5
	select MBEDTLS_ENABLE_SHA1
	---help---
		Enable SSL 3.0 support.

config MBEDTLS_TLS10
	bool "Enable TLS 1.0 support"
	default n
	select MBEDTLS_ENABLE_CBC
	select MBEDTLS_ENABLE_MD5
	select MBEDTLS_ENABLE_SHA1
	---help---
		Enable TLS 1.0 support.

config MBEDTLS_TLS11
	bool "Enable TLS 1.1 / DTLS 1.0 support"
	default n
	select MBEDTLS_ENABLE_CBC
	select MBEDTLS_ENABLE_MD5
	select MBEDTLS_ENABLE_SHA1
	---help---
		Enable TLS 1.1 and DTLS 1.0 support.

config MBEDTLS_TLS12
	bool "Enable TLS 1.2 / DTLS 1.2 support"
	default y
	depends on MBEDTLS_ENABLE_CBC || MBEDTLS_ENABLE_GCM || MBEDTLS_ENABLE_CCM
	select MBEDTLS_ENABLE_SHA256
	---help---
		Enable TLS 1.2 and DTLS 1.2 support.

config MBEDTLS_DTLS
	bool "Enable DTLS support"
	default n
	depends on MBEDTLS_TLS11 || MBEDTLS_TLS12
	---help---
		Enable Datagram Transport Layer Security (DTLS) support.

config MBEDTLS_RENEGOTIATION
	bool "Enable renegotiation support"
	default n
	---help---
		Enable TLS renogotiation support.

config MBEDTLS_MAX_FRAGMENT
	bool "Enable Maximum Fragment Length Negotiation TLS extension"
	default y
	---help---
		Enable Maximum Fragment Length Negotiation TLS extension (RFC 6066).

config MBEDTLS_TRUNCATED_HMAC
	bool "Enable Truncated HMAC TLS extension"
	default n
	---help---
		Enable Truncated HMAC TLS extension (RFC 6066).

config MBEDTLS_SESSION_TICKET
	bool "Enable Session Ticket TLS extension"
	default y
	---help---
		Enable Session Ticket TLS extension (RFC 5077).

config MBEDTLS_MAX_FRAGMENT_LEN
	int "Maximum fragment length in bytes"
	default 0
	---help---
		Maximum fragment length in bytes, determines the size of each of
		the two internal I/O buffers.

		Note: output fragment size can be overridden by
		MBEDTLS_MAX_OUT_FRAGMENT_LEN setting.

		Note: the RFC defines the default size of SSL / TLS messages.
		If you change the value here, other clients / servers may not
		be able to communicate with you anymore. Only change this value
		if you control both sides of the connection and have it reduced
		at both sides, or if you're using the Max Fragment Length
		extension and you know all your peers are using it too!

		Setting to '0' will select protocol default maximum fragment
		length which is 16 KiB (16384 bytes).

config MBEDTLS_MAX_OUT_FRAGMENT_LEN
	int "Maximum output fragment length in bytes"
	default 0
	---help---
		Maximum fragment length in bytes, determines the size of the internal
		output I/O buffer.

		Note: the RFC defines the default size of SSL / TLS messages.
		If you change the value here, output messages have smaller fragment
		size than maximum specified for protocol. This setting allows
		reducing RAM usage at expense of additional networking overhead.

		Setting to '0' will select protocol default maximum fragment
		length which is 16 KiB (16384 bytes).

config MBEDTLS_ENABLE_PSK
	bool "Enable PSK ciphersuite modes"
	default n

config MBEDTLS_ENABLE_CTR_DRBG
	bool "Enable the CTR_DRBG AES-256-based random generator"
	select MBEDTLS_ENABLE_AES
	default y

config MBEDTLS_ENABLE_HMAC_DRBG
	bool "Enable the HMAC_DRBG random generator"
	default y

config MBEDTLS_ENABLE_RSA
	bool "Enable RSA support"
	default y

config MBEDTLS_ENABLE_DH
	bool "Enable DH support"
	default y

config MBEDTLS_ENABLE_ECDH
	bool "Enable ECDH support"
	select MBEDTLS_ENABLE_EC
	default y

config MBEDTLS_ENABLE_ECDSA
	bool "Enable ECDSA support"
	select MBEDTLS_ENABLE_EC
	select MBEDTLS_ENABLE_HMAC_DRBG
	default n

config MBEDTLS_ENABLE_EC
	bool "Enable ECC support"
	select MBEDTLS_EC_SECP256R1
	select MBEDTLS_ENABLE_SHA256
	default n

if MBEDTLS_ENABLE_EC
config MBEDTLS_ENABLE_ALL_EC_CURVES
	bool "Enable all EC curves"
	select MBEDTLS_EC_SECP192R1
	select MBEDTLS_EC_SECP224R1
	select MBEDTLS_EC_SECP256R1
	select MBEDTLS_EC_SECP384R1
	select MBEDTLS_EC_SECP521R1
	select MBEDTLS_EC_SECP192K1
	select MBEDTLS_EC_SECP224K1
	select MBEDTLS_EC_SECP256K1
	select MBEDTLS_EC_BP256R1
	select MBEDTLS_EC_BP384R1
	select MBEDTLS_EC_BP512R1
	select MBEDTLS_EC_CURVE25519
	default n
	---help---
		Enable all EC curves.

config MBEDTLS_EC_SECP192R1
	bool "Enable secp192r1 curve"
	default n

config MBEDTLS_EC_SECP224R1
	bool "Enable secp224r1 curve"
	default n

config MBEDTLS_EC_SECP256R1
	bool "Enable secp256r1 curve"
	default n

config MBEDTLS_EC_SECP384R1
	bool "Enable secp384r1 curve"
	default n

config MBEDTLS_EC_SECP521R1
	bool "Enable secp521r1 curve"
	default n

config MBEDTLS_EC_SECP192K1
	bool "Enable secp192k1 curve"
	default n

config MBEDTLS_EC_SECP224K1
	bool "Enable secp224k1 curve"
	default n

config MBEDTLS_EC_SECP256K1
	bool "Enable secp256k1 curve"
	default n

config MBEDTLS_EC_BP256R1
	bool "Enable brainpoolP256r1 curve"
	default n

config MBEDTLS_EC_BP384R1
	bool "Enable brainpoolP384r1 curve"
	default n

config MBEDTLS_EC_BP512R1
	bool "Enable brainpoolP512r1 curve"
	default n

config MBEDTLS_EC_CURVE25519
	bool "Enable curve25519 curve"
	default n

endif #MBEDTLS_ENABLE_EC

config MBEDTLS_ENABLE_CBC
	bool "Enable CBC cipher mode"
	default y

config MBEDTLS_ENABLE_CFB
	bool "Enable CFB cipher mode"
	default n

config MBEDTLS_ENABLE_CTR
	bool "Enable CTR cipher mode"
	default n

config MBEDTLS_ENABLE_GCM
	bool "Enable GCM AEAD cipher mode"
	default y

config MBEDTLS_ENABLE_CCM
	bool "Enable CCM AEAD cipher mode"
	default n

config MBEDTLS_ENABLE_AES
	bool "Enable AES cipher algorithm"
	default y

config MBEDTLS_ENABLE_3DES
	bool "Enable triple-DES cipher algorithm"
	default n

config MBEDTLS_ENABLE_BLOWFISH
	bool "Enable Blowfish cipher algorithm"
	default n

config MBEDTLS_ENABLE_RC4
	bool "Enable RC4 cipher algorithm"
	default n

config MBEDTLS_ENABLE_CAMELLIA
	bool "Enable Camellia cipher algorithm"
	default n

config MBEDTLS_ENABLE_MD4
	bool "Enable MD4 hash algorithm"
	default n

config MBEDTLS_ENABLE_MD5
	bool "Enable MD5 hash algorithm"
	default n

config MBEDTLS_ENABLE_SHA1
	bool "Enable SHA-1 hash algorithm"
	default y

config MBEDTLS_ENABLE_SHA256
	bool "Enable SHA-256 hash algorithm"
	default y

config MBEDTLS_ENABLE_SHA512
	bool "Enable SHA-512 hash algorithm"
	default n

config MBEDTLS_ENABLE_RIPEMD
	bool "Enable RIPEMD-160 hash algorithm"
	default n

endif #MBEDTLS
```

## apps/netutils/ntpclient/Kconfig
```kconfig
#
# For a description of the syntax of this configuration file,
# see misc/tools/kconfig-language.txt.
#

config NETUTILS_NTPCLIENT
	bool "NTP client"
	default n
	depends on NET_UDP
	---help---
		Enable support for the minimal NTP client.

if NETUTILS_NTPCLIENT

config NETUTILS_NTPCLIENT_SERVERHOSTNAME
	string "NTP server hostnames"
	default "0.pool.ntp.org;1.pool.ntp.org;2.pool.ntp.org"
	---help---
		List of NTP server hostnames to use. Server names need to be separated
		by ';'.

config NETUTILS_NTPCLIENT_PORTNO
	int "NTP server port number"
	default 123

config NETUTILS_NTPCLIENT_STACKSIZE
	int "NTP client daemon stack stack size"
	default 2048

config NETUTILS_NTPCLIENT_SERVERPRIO
	int "NTP client daemon priority"
	default 100

config NETUTILS_NTPCLIENT_POLLDELAYSEC
	int "NTP client poll interval (seconds)"
	default 60

config NETUTILS_NTPCLIENT_RETRIES
	int "NTP client retry seconds to wait for network up"
	default 60

config NETUTILS_NTPCLIENT_NUM_SAMPLES
	int "NTP client number of samples collected for filter"
	default 5

config NETUTILS_NTPCLIENT_SIGWAKEUP
	int "NTP client wakeup signal number"
	default 18
	depends on !DISABLE_SIGNALS

endif # NETUTILS_NTPCLIENT
```

## apps/netutils/tinycbor/Kconfig
```kconfig
#
# For a description of the syntax of this configuration file,
# see misc/tools/kconfig-language.txt.
#

config NETUTILS_TINYCBOR
	bool "TinyCBOR library"
	default n
	---help---
		TinyCBOR: RFC 7049 Concise Binary Object Representation (CBOR)
		Library

		“The Concise Binary Object Representation (CBOR) is a data
		format whose design goals include the possibility of extremely
		small code size, fairly small message size, and extensibility
		without the need for version negotiation.”

if NETUTILS_TINYCBOR

endif # NETUTILS_TINYCBOR
```

## apps/system/conman/Kconfig
```kconfig
#
# For a description of the syntax of this configuration file,
# see misc/tools/kconfig-language.txt.
#

menu "Connection manager"
config SYSTEM_CONMAN
	bool "Connection manager"
	default n
	---help---
		Enable the library for controlling device network connections

if SYSTEM_CONMAN

config SYSTEM_CONMAN_DEBUG
	bool "Enable connection manager debug"
	default n
	---help---
		Enable connection manager debug.

config SYSTEM_CONMAN_VERBOSE
	bool "Enable connection manager verbose debug"
	default n
	---help---
		Enable connection manager verbose debug.

config SYSTEM_CONMAN_WIFI
	bool "Enable connection manager wifi"
	default y
	---help---
		Enable connection manager wifi

endif
endmenu
```

## apps/system/display/Kconfig
```kconfig
#
# For a description of the syntax of this configuration file,
# see misc/tools/kconfig-language.txt.
#

menu "Device display"
menuconfig THINGSEE_DISPLAY_MODULE
    bool "Thingsee display module support"
    default n
    ---help---
        Enable the Thingsee application support display

if THINGSEE_DISPLAY_MODULE

config THINGSEE_DISPLAY_TRACES
    bool "Enable trace support for display"
    default n
    ---help---
        Enables trace support for display

config THINGSEE_DISPLAY_BKGND_COLOR
    int "Background color used in apps"
    default 0
    ---help---
        Background color used in application

config THINGSEE_DISPLAY_FOREGND_COLOR
    int "Foreground color used in apps"
    default 1
    ---help---
        Foreground color used in apps

config THINGSEE_DISPLAY_QR
    bool "Thingsee support for qr code"
    default n
    ---help---
        Enable test-algorithm for qr code. At the moment the version of this algorithm is not even alpha

if THINGSEE_DISPLAY_QR
    config THINGSEE_MASKING_OFF
        bool "Turns off masking calculating"
        default n
        ---help---
            Turns off masking calculation. Every single mask is intend to remove noise and depricated features
            from the symbol. BUT it is significatly slowing down the symbol generating process. Most of the vendors
            just hardcode a random mask that might be a problem in a very noisy environment while the one trying to
            decode a symbol
endif

# This definition is not about image module. But in future it must be placed under IMAGE_MODULE macro definition
config THINGSEE_DISPLAY_INC_IMG_EXAMPLE
    bool "Image example to play with"
    default n
    ---help---
        This option includes image example if needed

config THINGSEE_DISPLAY_INVERT
    bool "Enable support for screen zone inverting"
    default n
    ---help---
        This option enables support for inverting user defined zone on the screen

config THINGSEE_DISPLAY_ALIGNMENT
    bool "Activate support for the text alignment"
    default n
    ---help---
        This option activates text alignment support. It will reduce possible flickering, but at the same time will slow down
        the rendering process due to the need of more calculations to be done before rendering process

endif
endmenu
```

## apps/system/ubgps/Kconfig
```kconfig
#
# For a description of the syntax of this configuration file,
# see misc/tools/kconfig-language.txt.
#

menu "u-blox GPS module support"
config SYSTEM_UBGPS
	bool "u-blox 7 GPS module support"
	default n
	depends on SERIAL_TERMIOS
	---help---
		Enable the Thingsee application support for u-blox 7 GPS module

if SYSTEM_UBGPS

config SYSTEM_UBGPS_DEBUG
	bool "Enable GPS debug"
	default n
	---help---
		Enable GPS debug.

config SYSTEM_UBGPS_VERBOSE_DEBUG
	bool "Enable verbose GPS debug"
	default n
	---help---
		Enable verbose GPS debug.

config SYSTEM_UBGPS_LNA_CONTROL
	bool "Enable LNA control"
	default n
	---help---
		Enable external low noise amplifier (LNA) control.

config UBGPS_DISABLE_POWERSAVE
	bool "Disable GPS power-save (force continuous mode)"
	default n
	---help---
		Disable GPS power-save mode.

config UBGPS_DISABLE_BOARD_POWERSAVE_CONTROL
	bool "Disable GPS board-level PM control"
	default n
	---help---
		Disable GPS board-level PM control (disallow MCU deep-sleep when GPS
		on).

config SYSTEM_UBGPS_LNA_PIN
	int "Pin used for LNA control"
	default 16
	---help---
		Pin used for LNA control.

config UBGPS_ASSIST_UPDATER
	bool "Enable assist data updater"
	default n
	---help---
		Enable automatic assist data updates from u-blox server.

config UBGPS_3DFIX_ONLY
	bool "Only allow 3D fixes"
	default n
	---help---
		Only allow 3D fixes, disable degraded navigation solutions (2D, etc).

config UBGPS_DISALLOW_ACQ_FIX
	bool "Do not allow fixes from acquisition state"
	default n
	---help---
		Only allow fixes from 'tracking' and 'power-save optimized tracking'.
		Acquisition fixes may not be fully stable and can have significant
		inaccuracies.

config UBGPS_DYNAMIC_MODEL
	int "Navigation engine dynamic platform model"
	default 4
	---help---
		Adjust navigation engine dynamic platform model to the expected
		application environment. 0 - portable, 2 - stationary, 3 - pedestrian,
		4 - automotive, 5 - at sea, 6 - airborne 1g, 7 - airborne 2g,
		8 - airborne 4g.

config UBGPS_POSITION_ACCURACY_MASK
	int "Position accuracy mask in meters"
	default 100
	---help---
		Position accuracy in meters that defines threshold value for navigation
		output filters whether the fix should be classified as valid or not.

config UBGPS_ACCURACY_FILTER_DURATION
	int "Time duration in seconds for horizontal accuracy filter"
	default 10
	---help---
		Duration of horizontal accuracy filter for location events. Accuracy
		filter collects location events and publish the most accurate location
		received within filtering period. Note that accuracy filter causes delay
		for requested navigation rate that is equal for filter duration.
		Set threshold to 0 in order to disable accuracy filter.

config UBGPS_ACCURACY_FILTER_THRESHOLD
	int "Horizontal accuracy threshold in meters"
	default 100
	---help---
		Horizontal accuracy value in meters that is intepreted as valid location
		information. Horizontal accuracy value below threshold causes accuracy
		filter to stop collecting location events. Set threshold to 0 in order
		to disable threshold functionality.

endif
endmenu
```
